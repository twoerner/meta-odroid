## conf/machine/include/amlogic-meson.inc
```bitbake
# Amlogic Meson Soc family

SOC_FAMILY = "amlogic:meson"
require conf/machine/include/soc-family.inc

SERIAL_CONSOLE ?= "115200 ttyAML0"
UBOOT_CONSOLE ?= "console=ttyAML0,115200"
```

## conf/machine/include/amlogic-meson64.inc
```bitbake
# Amlogic Meson64 Configurations

SOC_FAMILY = "amlogic:meson-gx"
require conf/machine/include/amlogic-meson.inc

MACHINE_FEATURES_BACKFILL_CONSIDERED = "rtc"
```

## conf/machine/include/odroid-default-settings.inc
```bitbake
# Odroid BSP default settings

PREFERRED_PROVIDER_virtual/xserver ?= "xserver-xorg"
XSERVER ?= "xserver-xorg \
           xf86-input-evdev \
           xf86-input-mouse \
           xf86-video-fbdev \
           xf86-input-keyboard"


PREFERRED_PROVIDER_virtual/kernel ?= "linux-stable"
PREFERRED_VERSION_linux-stable ?= "4.9%"
LINUX_VERSION_EXTENSION ?= "-odroid"

KERNEL_IMAGETYPE ?= "zImage"
UBOOT_BINARY ?= "u-boot-dtb.bin"

MACHINE_FEATURES = "serial usbgadget usbhost vfat ext2 alsa screen"
MACHINE_EXTRA_RRECOMMENDS = " kernel-modules kernel-devicetree"

IMAGE_FSTYPES_append = " ext4 sdcard"
```

## conf/machine/include/odroid-xu-default.inc
```bitbake
# Odroid XU default BSP

include conf/machine/include/samsung-exynos.inc
include conf/machine/include/odroid-default-settings.inc

DEFAULTTUNE = "cortexa15hf-neon"
include conf/machine/include/tune-cortexa15.inc

UBOOT_FDT_LOADADDR = "0x40800000"
UBOOT_LOADADDR = "0x40007FC0"
UBOOT_LOADADDRESS = "0x40007FC0"
UBOOT_CONSOLE = "console=ttySAC2,115200"
UBOOT_KERNEL_NAME = "zImage"
UBOOT_XTRA_CMDLINE = "usbhid.quirks=0x0eef:0x0005:0x0004"

WKS_FILE ?= "odroid_xu-u-boot.wks"

EXTRA_IMAGEDEPENDS += "secure-odroid"
MACHINE_FEATURES_append = " alsa screen"

PREFERRED_PROVIDER_virtual/egl = "mali-t62x"
PREFERRED_PROVIDER_virtual/libgbm = "mali-t62x"
PREFERRED_PROVIDER_virtual/libgles1 = "mali-t62x"
PREFERRED_PROVIDER_virtual/libgles2 = "mali-t62x"
PREFERRED_PROVIDER_virtual/libopencl = "mali-t62x"
PREFERRED_PROVIDER_virtual/libgl = "mesa"
PREFERRED_PROVIDER_virtual/mesa = "mesa"

MALI = "\
    kernel-module-mali-t62x \
    mali-t62x\
"

XSERVER ?= " \
    xserver-xorg \
    ${@bb.utils.contains('DISTRO_FEATURES', 'opengl', 'xserver-xorg-extension-glx', '', d)} \
    ${@bb.utils.contains('MACHINE_FEATURES', 'mali', 'xf86-driver-armsoc', '', d)} \
    xf86-video-fbdev \
    xf86-video-modesetting \
    xf86-input-evdev \
    xf86-input-mouse \
    xf86-input-keyboard \
    xserver-xorg-module-libint10 \
"
```

## conf/machine/include/samsung-exynos.inc
```bitbake
# Samsung exynos

SOC_FAMILY = "samsung:exynos"
require conf/machine/include/soc-family.inc

SERIAL_CONSOLE ?= "115200 ttySAC2"
```

## conf/machine/odroid-c1.conf
```bitbake
#@TYPE: Machine
#@NAME: ODROID-C1
#@DESCRIPTION: Machine configuration for the ODROID-C1 by Hardkernel

DEFAULTTUNE ?= "cortexa5hf-neon"
require conf/machine/include/tune-cortexa5.inc
include conf/machine/include/odroid-default-settings.inc

MACHINE_EXTRA_RRECOMMENDS += "u-boot-config"

#PREFERRED_PROVIDER_virtual/kernel = "linux-hardkernel"
PREFERRED_VERSION_linux-hardkernel = "3.10%"

PREFERRED_PROVIDER_virtual/bootloader ?= "u-boot-hardkernel"
PREFERRED_PROVIDER_u-boot ?= "u-boot-hardkernel"
PREFERRED_VERSION_u-boot-hardkernel ?= "v2011.03%"

UBOOT_MACHINE ?= "odroidc_config"

UBOOT_SUFFIX ?= "bin"
UBOOT_BINARY = "u-boot.${UBOOT_SUFFIX}"
UBOOT_SYMLINK ?= "u-boot-${MACHINE}.${UBOOT_SUFFIX}"
UBOOT_ENTRYPOINT = "00208000"
KERNEL_EXTRA_ARGS += "LOADADDR=${UBOOT_ENTRYPOINT}"

KERNEL_DEVICETREE ?= "meson8b-odroidc1.dtb"
SERIAL_CONSOLE = "115200 ttyAML0"

KERNEL_IMAGETYPE = "uImage"
BOOT_IMAGE = "uImage"
UBOOT_ENV_SUFFIX ?= "ini"
UBOOT_LOADADDR ?= "0x21000000"
UBOOT_FDT_LOADADDR ?= "0x21800000"
UB_LOAD_CMD ?= "fatload"
UB_FILE_TITLE ?= "ODROIDC-UBOOT-CONFIG"
UBOOT_CONSOLE ?= "console=ttyAML0,115200"
UBOOT_BOOT_CMD ?= "bootm"
UBOOT_KENREL_NAME ?= "uImage"

IMAGE_CLASSES += "image_types_odroid"
```

## conf/machine/odroid-c2.conf
```bitbake
#@TYPE: Machine
#@NAME: odroid-c2
#@DESCRIPTION: Machine configuration for odroid-c2 systems
#@MAINTAINER: Armin Kuster <akuster808@gmail.com>

include confi/machin/include/amlogic-meson.inc

DEFAULTTUNE ?= "aarch64"
require conf/machine/include/arm/arch-armv8.inc
include conf/machine/include/odroid-default-settings.inc

EXTRA_IMAGEDEPENDS += "u-boot secure-odroid-c2 u-boot-config"

MACHINE_FEATURES_BACKFILL_CONSIDERED = "rtc"

SERIAL_CONSOLE = "115200 ttyAML0"
KERNEL_DEVICETREE_FN = "meson-gxbb-odroidc2.dtb"
KERNEL_DEVICETREE = "amlogic/meson-gxbb-odroidc2.dtb"

#specify u-boot parameters
PREFERRED_PROVIDER_virtual/bootloader ?= "u-boot"
PREFERRED_PROVIDER_u-boot ?= "u-boot"
PREFERRED_VERSION_u-boot = "2017.05"
UBOOT_MACHINE_odroid-c2 = "odroid-c2_defconfig"

KERNEL_IMAGETYPE = "Image"

UBOOT_ENV_SUFFIX ?= "scr"
UBOOT_LOADADDR ?= "0x01080000"
UBOOT_FDT_LOADADDR ?= "0x01000000"
UB_LOAD_CMD ?= "fatload"
UBOOT_CONSOLE ?= "console=ttyAML0,115200"
UBOOT_BOOT_CMD ?= "booti"
UBOOT_KENREL_NAME ?= "uimage"

IMAGE_CLASSES += "image_types_odroid"
```

## conf/machine/odroid-n1.conf
```bitbake
#@TYPE: Machine
#@NAME: odroid-n1
#@DESCRIPTION: Machine configuration for odroid-n1 systems
#The Rockchip RK3399 is a ARM-based SoC with a dual-core Cortex-A72
#and quad-core Cortex-A53.
#including NEON and GPU, 1MB L2 cache, Mali-T7 graphics, two
#video interfaces supporting HDMI and eDP, several DDR3 options
#and video codec support. Peripherals include Gigabit Ethernet,
#USB2 host and OTG, SDIO, I2S, UARTs, SPI, I2C and PWMs.
#@MAINTAINER: Armin Kuster <akuster808@gmail.com>


DEFAULTTUNE ?= "aarch64"
require conf/machine/include/arm/arch-armv8.inc
include conf/machine/include/odroid-default-settings.inc

EXTRA_IMAGEDEPENDS += "u-boot"

KERNEL_DEVICETREE = "rockchip/rk3399-evb"

#specify u-boot parameters
UBOOT_MACHINE_odroid-n1 = "evb-rk3399_defconfig"

KERNEL_IMAGETYPE = "Image"

IMAGE_CLASSES += "image_types_odroid"
```

## conf/machine/odroid-xu.conf
```bitbake
#-----------------------------------------------------------------------------
#@TYPE: Machine
#@NAME: ODROID-XU Exynos Octa
#@DESCRIPTION: Machine configuration for the ODROID-XU by hardkernel
#-----------------------------------------------------------------------------

TARGET_ARCH = "arm"

#specify kernel
PREFERRED_PROVIDER_virtual/kernel = "linux-hardkernel"
PREFERRED_VERSION_virtual/kernel  = "3.4"

#specify u-boot parameters
PREFERRED_PROVIDER_virtual/bootloader = "u-boot-hardkernel"
PREFERRED_PROVIDER_u-boot = "u-boot-hardkernel"
PREFERRED_VERSION_u-boot-hardkernel = "2012.07"

#replace with correct config
UBOOT_MACHINE = "smdk5410_config"

KERNEL_IMAGETYPE = "zImage"
IMAGE_FSTYPES += "tar.gz"

SERIAL_CONSOLE = "115200 ttySAC2"

require conf/machine/include/tune-cortexa7.inc
```

## conf/machine/odroid-xu4s.conf
```bitbake
#@TYPE: Machine
#@NAME: odroid-xu4s
#@DESCRIPTION: Machine configuration for odroid-xu4s systems
#@MAINTAINER: Armin Kuster <akuster808@gmail.com>


include conf/machine/include/odroid-xu-default.inc

KERNEL_DEVICETREE ?= "exynos5422-odroidxu4.dtb"
UBOOT_MACHINE_odroid-xu4s = "odroid-xu3_defconfig"
```

## meta-odroid-extras/conf/layer.conf
```bitbake
# We have a conf and classes directory, add to BBPATH
BBPATH .= ":${LAYERDIR}"

# We have recipes-* directories, add to BBFILES
BBFILES += "${LAYERDIR}/recipes-*/*/*.bb \
        ${LAYERDIR}/recipes-*/*/*.bbappend"

BBFILE_COLLECTIONS += "odroid-extra-layer"
BBFILE_PATTERN_odroid-extra-layer = "^${LAYERDIR}/"
BBFILE_PRIORITY_odroid-extra-layer = "7"

LAYERDEPENDS_odroid-extra-layer = "core odroid-layer"

LAYERSERIES_COMPAT_odroid-extra-layer = "sumo"
```
